## release/src-rt-5.02axhnd/bcmdrivers/broadcom/net/wl/impl51/main/src/toolchains/crosstools-gcc-5.3-linux-4.1-uclibc-1.0.12-glibc-2.24-binutils-2.25/src/buildroot-2016.02/package/glibc/Config.in
```kconfig
if BR2_TOOLCHAIN_BUILDROOT_EGLIBC

config BR2_PACKAGE_EGLIBC
	bool
	default y
	select BR2_PACKAGE_LINUX_HEADERS

choice
	prompt "eglibc version"
	default BR2_EGLIBC_VERSION_2_18

config BR2_EGLIBC_VERSION_2_18
	bool "2.18-svnr23787"
	# Build breakage
	depends on !BR2_sparc

config BR2_EGLIBC_VERSION_2_19
	bool "2.19-svnr25243"
	# Build breakage
	depends on !BR2_powerpc_SPE

endchoice

endif

if BR2_TOOLCHAIN_BUILDROOT_GLIBC

config BR2_PACKAGE_GLIBC
	bool
	default y
	select BR2_PACKAGE_LINUX_HEADERS

choice
	prompt "glibc version"
	default BR2_GLIBC_VERSION_2_21

config BR2_GLIBC_VERSION_2_21
	bool "2.21"

config BR2_GLIBC_VERSION_2_22
	bool "2.22"
	depends on !BR2_sparc # broken

config BR2_GLIBC_VERSION_2_23
	bool "2.23"

config BR2_GLIBC_VERSION_2_24
	bool "2.24"
	# Linux 3.2 or later kernel headers are required on all arches.
	# See: https://sourceware.org/ml/libc-alpha/2016-08/msg00212.html
	depends on BR2_TOOLCHAIN_HEADERS_AT_LEAST_3_2

comment "glibc-2.24 needs kernel headers >= 3.2"
	depends on !BR2_TOOLCHAIN_HEADERS_AT_LEAST_3_2
endchoice

endif

config BR2_GLIBC_VERSION_STRING
	string
	default "2.18-svnr23787" if BR2_EGLIBC_VERSION_2_18
	default "2.19-svnr25243" if BR2_EGLIBC_VERSION_2_19
	default "2.21" if BR2_GLIBC_VERSION_2_21
	default "2.22" if BR2_GLIBC_VERSION_2_22
	default "2.23" if BR2_GLIBC_VERSION_2_23
	default "2.24" if BR2_GLIBC_VERSION_2_24
```
